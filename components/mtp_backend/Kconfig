## components/usb_composite/Kconfig
```kconfig
menu "USB composite (I1)"

    config USB_COMPOSITE_MSOS_FUNCTION_SUBSET
        bool "Emit a Function Subset Header (0x0002) for each WCID function"
        default y
        help
            MS OS 2.0 规范形态。probe-report §5（U8）与 §2.5 互相矛盾：
            §2.5 说模式 B（带 Function Subset Header + 单数 REG_SZ）真机 Chrome claim 成功，
            §5 却把该组合列为未验证。本阶段设备不可用，两开关都默认 y。
            上电后第一优先复测 —— 见 docs/contracts/frozen-allocation.md §5.1 与
            docs/device-test-requests.md。

    config USB_COMPOSITE_MSOS_CONFIG_SUBSET
        bool "Emit a Configuration Subset Header (0x0001) before the function subsets"
        default n
        help
            默认**关**：探测期真机验证过的形态（模式 B，166 B）**没有**这一节，
            见 docs/contracts/frozen-allocation.md §5.2。
            打开它 = 做一次 A/B 实验（多一个功能时是否该补 Configuration Subset，没有任何真机证据）。
            保持关闭时，MS OS 2.0 描述符集与已验证形态逐字节一致。

    config USB_COMPOSITE_SELFCHECK_ON_BOOT
        bool "Run the offline descriptor/budget self-check during usb_composite_start()"
        default y
        help
            逐字节解析自己组装出来的描述符，与 docs/contracts/frozen-allocation.md 冻结节逐项比对，
            并复算 DWC2 FIFO 预算。这是**离线自检**，不替代真机枚举。

    config USB_COMPOSITE_VBUS_MONITOR_IO
        int "VBUS monitor GPIO (-1 = disabled)"
        default -1
        help
            自供电时用于监测 VBUS。板子由总线供电时保持 -1。

    config USB_COMPOSITE_SELF_POWERED
        bool "Declare the device as self-powered"
        default n

    config USB_COMPOSITE_MAX_POWER_MA
        int "bMaxPower declaration in mA"
        default 500
        range 100 500

endmenu
```

## components/usb_probe/Kconfig
```kconfig
menu "USB probe (components/usb_probe)"

    config USB_PROBE_MTP_ITF_ENABLE
        bool "Include the MTP interface in the probe configuration descriptors (mode B)"
        default y if TINYUSB_MTP_ENABLED
        default n
        help
            usb_probe 的 FS/HS 配置描述符里是否包含 MTP 接口（IF0，EP1 事件 + EP2 数据），
            Vendor 回环接口随之从 IF0/EP1（模式 A）变为 IF1/EP3（模式 B）。

            这个开关必须与 CONFIG_TINYUSB_MTP_ENABLED 保持一致，否则描述符表会和
            TinyUSB 里实际启用/未启用的类驱动脱钩（usb_probe.c 用 #error 强制检查）。
            端点分配见 docs/probe-contract.md §1，不要在探测期单方面改动。

    config USB_PROBE_DEVICE_CLASS_IAD
        bool "Declare the device as composite: bDeviceClass=0xEF/0x02/0x01 (Misc/IAD)"
        default y if TINYUSB_MTP_ENABLED
        default n
        help
            控制 **device 描述符** 的 bDeviceClass/SubClass/Protocol：

              y = 0xEF / 0x02 / 0x01（Misc / Common / IAD）→ Windows 挂 usbccgp，
                  再按接口把 MTP 交给 wpdmtp.sys、把 vendor 接口交给 winusb.sys。
                  模式 B（MTP + Vendor 复合）**必须**用这个值。
              n = 0xFF / 0x00 / 0x00（Vendor Specific，非复合）→ 父节点自己就是功能设备，
                  是"WebUSB on Windows"的经典形态。模式 A（单 Vendor）默认用这个值：
                  真机实测复合形态下 vendor 子接口拿不到 GUID_DEVINTERFACE_USB_DEVICE
                  ({A5DCBF10-…})，Chrome 因此看不到设备。

            这个开关只影响 device 描述符的类字段；接口/端点分配（契约 §1）不随它变化。
            usb_probe.c 里有编译期检查：模式 B 若被置成 n 会直接 #error。

endmenu
```
